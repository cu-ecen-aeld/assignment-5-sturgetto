## base_external/Config.in
```kconfig
menu "External Projects"
	source "../base_external/package/aesd-assignments/Config.in"
endmenu
```

## base_external/package/ldd/Config.in
```kconfig
config BR2_PACKAGE_LDD
	bool "ldd"
	default y
	help
	  Includes the ldd, misc_module and scull modules in the kernel.
```
